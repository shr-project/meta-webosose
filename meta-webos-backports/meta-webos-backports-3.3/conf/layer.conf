## meta-webos-backports/meta-webos-backports-3.3/conf/layer.conf
```bitbake
# Copyright (c) 2021-2022 LG Electronics, Inc.

# We have conf and classes directories => add to BBPATH
BBPATH .= ":${LAYERDIR}"

# We have recipes-* directories => add to BBFILES
BBFILES += "${LAYERDIR}/recipes-*/*/*.bb \
            ${LAYERDIR}/recipes-*/*/*.bbappend"

BBFILE_COLLECTIONS += "meta-webos-backports-3.3"
BBFILE_PATTERN_meta-webos-backports-3.3 := "^${LAYERDIR}/"
BBFILE_PRIORITY_meta-webos-backports-3.3 = "34"

LAYERSERIES_COMPAT_meta-webos-backports-3.3 = "gatesgarth"

LAYERDEPENDS_meta-webos-backports-3.3 = " \
core \
openembedded-layer \
"

# License mapping back to old license files
# First 3 are already included in
# meta-qt6/conf/layer.conf
SPDXLICENSEMAP[GPL-3.0-only] = "GPL-3.0"
SPDXLICENSEMAP[LGPL-3.0-only] = "LGPL-3.0"
SPDXLICENSEMAP[GPL-2.0-or-later] = "GPL-2.0"

SPDXLICENSEMAP[GPL-2.0-only] = "GPL-2.0"
SPDXLICENSEMAP[LGPL-2.1-only] = "LGPL-2.1"
SPDXLICENSEMAP[LGPL-2.1-or-later] = "LGPL-2.1"
SPDXLICENSEMAP[LGPL-2.0-only] = "LGPL-2.0"
SPDXLICENSEMAP[LGPL-2.0-or-later] = "LGPL-2.0"
```

## meta-webos-backports/meta-webos-backports-5.1/conf/layer.conf
```bitbake
# Copyright (c) 2024-2025 LG Electronics, Inc.

# We have conf and classes directories => add to BBPATH
BBPATH .= ":${LAYERDIR}"

# We have recipes-* directories => add to BBFILES
BBFILES += "${LAYERDIR}/recipes-*/*/*.bb \
            ${LAYERDIR}/recipes-*/*/*.bbappend"

BBFILE_COLLECTIONS += "meta-webos-backports-5.1"
BBFILE_PATTERN_meta-webos-backports-5.1 := "^${LAYERDIR}/"
BBFILE_PRIORITY_meta-webos-backports-5.1 = "34"

LAYERSERIES_COMPAT_meta-webos-backports-5.1 = "scarthgap"

LAYERDEPENDS_meta-webos-backports-5.1 = " \
    core \
    openembedded-layer \
"
```

## meta-webos-raspberrypi/conf/layer.conf
```bitbake
# Copyright (c) 2017-2022 LG Electronics, Inc.

BBPATH ?= ""
# We have a conf and classes directory, add to BBPATH
BBPATH .= ":${LAYERDIR}"
# We have a packages directory, add to BBFILES
BBFILES += "${LAYERDIR}/recipes-*/*/*.bb ${LAYERDIR}/recipes-*/*/*.bbappend"

BBFILE_COLLECTIONS += "meta-webos-raspberrypi"
BBFILE_PATTERN_meta-webos-raspberrypi := "^${LAYERDIR}/"
BBFILE_PRIORITY_meta-webos-raspberrypi = "51"

LAYERSERIES_COMPAT_meta-webos-raspberrypi = "langdale"

LAYERDEPENDS_meta-webos-raspberrypi = "\
    meta-webos \
    raspberrypi \
"

# Not compatible with our old Qt 5.6
BBMASK += "meta-raspberrypi/dynamic-layers/qt5-layer/recipes-qt/qt5/qtbase_%.bbappend"
# Temporarily until
# https://github.com/agherzan/meta-raspberrypi/pull/1150
# is merged
BBMASK += "meta-raspberrypi/recipes-multimedia/gstreamer/gstreamer1.0-plugins-good_1.20.%.bbappend"
```

## meta-webos/conf/distro/webos.conf
```bitbake
# Copyright (c) 2012-2023 LG Electronics, Inc.

DISTRO = "webos"
DISTRO_NAME = "webOS OSE"

WEBOS_DISTRO_VERSION_CODENAME = "master"
WEBOS_DISTRO_BUILD_CODENAME = "master"

# Software Version : A.B.x-C
# A: Major Version
# B: Minor Version
# x: build type
#    g - github

WEBOS_DISTRO_VERSION_MAJOR = "2"
WEBOS_DISTRO_VERSION_MINOR = "21.0"
WEBOS_DISTRO_VERSION_TYPE = "g"

DISTRO_VERSION = "${WEBOS_DISTRO_VERSION_MAJOR}.${WEBOS_DISTRO_VERSION_MINOR}.${WEBOS_DISTRO_VERSION_TYPE}"

SDK_VENDOR = "-webossdk"

MAINTAINER = "Joseph Park <dongseon.park@lge.com>"

TARGET_VENDOR = "-webos"

require conf/distro/include/webos.inc

LICENSE_FLAGS_ACCEPTED:append = " \
    commercial_ffmpeg \
    commercial_gstreamer1.0-libav \
    commercial_gstreamer1.0-omx \
    commercial_gstreamer1.0-plugins-ugly \
    commercial_lame \
    commercial_libav \
    commercial_libomxil \
    commercial_mpeg2dec \
    commercial_mpg123 \
    commercial_x264 \
    synaptics-killswitch \
"
```
